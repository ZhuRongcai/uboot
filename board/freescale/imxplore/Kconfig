## board/freescale/imxplore/Kconfig
```kconfig
if TARGET_IMXPLORE

config SYS_BOARD
	default "imxplore"

config SYS_VENDOR
	default "freescale"

config SYS_CONFIG_NAME
	default "imxplore"

endif
```

## board/freescale/mx6ull_jarvis_emmc/Kconfig
```kconfig
if TARGET_MX6ULL_JARVIS_EMMC

config SYS_BOARD
	default "mx6ull_jarvis_emmc"

config SYS_VENDOR
	default "freescale"

config SYS_CONFIG_NAME
	default "mx6ull_jarvis_emmc"

endif
```
